## boards/shields/lily58/Kconfig.defconfig
```kconfig
# Common Lily58 settings
config ZMK_KEYBOARD_NAME
    string
    default "Lily58"

config ZMK_SPLIT
    bool
    default y

config ZMK_SPLIT_ROLE_CENTRAL
    bool
    default y if SHIELD_LILY58_LEFT || SHIELD_LILY58_DONGLE_XIAO || SHIELD_LILY58_DONGLE_PRO_MICRO

# Display-related settings
config I2C
    bool
    default y if ZMK_DISPLAY

config SSD1306
    bool
    default y if ZMK_DISPLAY

choice ZMK_DISPLAY_WORK_QUEUE
    default ZMK_DISPLAY_WORK_QUEUE_DEDICATED
    depends on ZMK_DISPLAY && (SHIELD_LILY58_DONGLE_XIAO || SHIELD_LILY58_DONGLE_PRO_MICRO)
endchoice

# LVGL display settings
config LV_Z_VDB_SIZE
    int
    default 64 if LVGL

config LV_DPI_DEF
    int
    default 148 if LVGL

config LV_Z_BITS_PER_PIXEL
    int
    default 1 if LVGL

choice LV_COLOR_DEPTH
    default LV_COLOR_DEPTH_1
    depends on LVGL
endchoice

# Cirque GlidePoint trackpad support
config INPUT_PINNACLE
    bool
    default y

config ZMK_POINTING
    bool
    default y
```

## config/west.yml
```yaml
manifest:
  remotes:
    - name: zmkfirmware
      url-base: https://github.com/zmkfirmware
    # Additional modules containing boards/shields/custom code can be listed here as well
    # See https://docs.zephyrproject.org/3.2.0/develop/west/manifest.html#projects
    - name: mctechnology17
      url-base: https://github.com/mctechnology17
    #petejohanson is a ZMK dev
    - name: petejohanson
      url-base: https://github.com/petejohanson
    #pm0u refrences pete for the cirque trackpad
    - name: pm0u
      url-base: https://github.com/pm0u

  projects:
    - name: zmk
      remote: zmkfirmware
      revision: main
      import: app/west.yml
    # support nice_oled and nice_epaper
    - name: zmk-nice-oled
      remote: mctechnology17
      revision: main
    #pete is a ZMK dev.
    - name: cirque-input-module
      remote: petejohanson
      revision: main
    #pm0u cirque section that uses pete
    - name: glidepoint_i2c
      remote: pm0u
      revision: main
      path: modules/glidepoint_i2c
  self:
    path: config
```
